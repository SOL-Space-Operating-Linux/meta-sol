## conf/layer.conf
```bitbake
BBPATH .= ":${LAYERDIR}"
BBFILES += " \
    ${LAYERDIR}/recipes-*/*/*.bb \
    ${LAYERDIR}/recipes-*/*/*.bbappend \
"


BBFILE_COLLECTIONS += "ssrl-tx2i"
BBFILE_PATTERN_ssrl-tx2i = "^${LAYERDIR}/"
BBFILE_PRIORITY_ssrl-tx2i = "100"

LAYERVERSION_ssrl-tx2i = "1"

LAYERDEPENDS_ssrl-tx2i = "tegra"

LAYERSERIES_COMPAT_ssrl-tx2i = "zeus"
```

## conf/machine/jetson-tx2-sol-redundant-live.conf
```bitbake
#@TYPE: Machine
#@NAME: Nvidia Jetson TX2 with linaro gcc
#@DESCRIPTION: Nvidia Jetson TX2 dev board

TEGRA_UCM ?= "ucm1"
NVPMODEL ?= "nvpmodel_t186_storm_${TEGRA_UCM}"

TEGRA_BOARDID ?= "3310"
TEGRA_FAB ?= "C04"
# Extracted from l4t_generate_soc_bup.sh for BOARDID=3489 and board=jetson-tx2i
TEGRA_BUPGEN_SPECS ?= "fab=B00 fab=B02 fab=C04 fab=D00 fab=D01"

#Specify RT Kernel
PREFERRED_PROVIDER_virtual/kernel ?= "linux-tegra-rt"
#PREFERRED_PROVIDER_virtual/kernel ?= "linux-tegra"

MACHINE_EXTRA_RRECOMMENDS += "tegra-firmware-brcm kernel-module-bcmdhd"

require conf/machine/include/tegra186.inc

#Specify Carrier Board DTB
KERNEL_DEVICETREE ?= "_ddot_/_ddot_/_ddot_/_ddot_/nvidia/platform/t18x/quill/kernel-dts/tegra186-quill-p3310-1000-c03-00-base.dtb"
KERNEL_ARGS ?= "console=ttyS0,115200 console=tty0 OS=l4t fbcon=map:0"

MACHINE_FEATURES += "ext2 ext3 vfat"

UBOOT_MACHINE = "p2771-0000-500_defconfig"

EMMC_SIZE ?= "31276924928"
EMMC_DEVSECT_SIZE ?= "512"
BOOTPART_SIZE ?= "8388608"
BOOTPART_LIMIT ?= "10485760"
ODMDATA ?= "0x1090000"
EMMC_BCT ?= "P3310_A00_8GB_Samsung_8GB_lpddr4_204Mhz_A02_l4t.cfg"
NVIDIA_BOARD ?= "t186ref"



#Specify INITRAMFS, specifically normal boot sequence, ext4.live or blob.live
#INITRAMFS_IMAGE = "tegra-minimal-initramfs"
#INITRAMFS_IMAGE = "tegra-minimal-initramfs-ext4.live"
INITRAMFS_IMAGE = "tegra-minimal-initramfs-blob.live"


#Specify partition layout (how many copies of things do you want where)
PARTITION_LAYOUT_TEMPLATE = "flash_t186_blob_rootfs.xml"
#PARTITION_LAYOUT_TEMPLATE = "flash_t186_redundant_rootfs.xml"
#PARTITION_LAYOUT_TEMPLATE = "flash_t186_default_rootfs.xml"

#Specify rootfs size (this may be duplicated based on partition layout)
ROOTFSPART_SIZE = "4294967296"
#ROOTFSPART_SIZE = "30064771072"

#Specify if NVIDIA redundancy is enabled or not
SMD_CFG = "${S}/bootloader/smd_info.redundant.cfg"
#SMD_CFG = "${S}/bootloader/smd_info.cfg"

# CUDA and GCC Compatibility
CUDA_VERSION = "10.0"

#CUDA 10.0 compatibility
GCCVERSION = "7.%"
require contrib/conf/include/gcc-compat.conf
```

## conf/machine/jetson-tx2i-sol-apl-redundant-live.conf
```bitbake
#@TYPE: Machine
#@NAME: Nvidia Jetson TX2i with linaro gcc
#@DESCRIPTION: Nvidia Jetson TX2i dev board

TEGRA_UCM ?= "ucm1"
NVPMODEL ?= "nvpmodel_t186_storm_${TEGRA_UCM}"

TEGRA_BOARDID ?= "3489"
TEGRA_FAB ?= "300"
# Extracted from l4t_generate_soc_bup.sh for BOARDID=3489 and board=jetson-tx2i
TEGRA_BUPGEN_SPECS ?= "fab=300"


#Specify RT Kernel
PREFERRED_PROVIDER_virtual/kernel ?= "linux-tegra-rt"
#PREFERRED_PROVIDER_virtual/kernel ?= "linux-tegra"

require conf/machine/include/tegra186.inc

#Specify Carrier Board DTB (custom carrier board requires linux-tegra-rt)
KERNEL_DEVICETREE ?= "tegra186-quill-p3489-1000-a00-00-ucm1-sol-custom.dtb"
KERNEL_ARGS ?= "console=ttyS0,115200 console=tty0 OS=l4t fbcon=map:0"

MACHINE_FEATURES += "ext2 ext3 vfat"

UBOOT_MACHINE = "p2771-0000-500_defconfig"

EMMC_SIZE ?= "31276924928"
EMMC_DEVSECT_SIZE ?= "512"
BOOTPART_SIZE ?= "8388608"
BOOTPART_LIMIT ?= "10485760"
ODMDATA ?= "0x1090000"
EMMC_BCT ?= "P3489_A00_8GB_Samsung_8GB_lpddr4_204Mhz_P134_A02_ECC_en_l4t.cfg"
NVIDIA_BOARD ?= "t186ref"


#Specify INITRAMFS, specifically normal boot sequence, ext4.live or blob.live
#INITRAMFS_IMAGE = "tegra-minimal-initramfs"
#INITRAMFS_IMAGE = "tegra-minimal-initramfs-ext4.live"
INITRAMFS_IMAGE = "tegra-minimal-initramfs-blob.live"


#Specify partition layout (how many copies of things do you want where)
PARTITION_LAYOUT_TEMPLATE = "flash_t186_blob_rootfs.xml"
#PARTITION_LAYOUT_TEMPLATE = "flash_t186_redundant_rootfs.xml"
#PARTITION_LAYOUT_TEMPLATE = "flash_t186_default_rootfs.xml"

#Specify rootfs size (this may be duplicated based on partition layout)
ROOTFSPART_SIZE = "4294967296"
#ROOTFSPART_SIZE = "30064771072"

#Specify if NVIDIA redundancy is enabled or not
SMD_CFG = "${S}/bootloader/smd_info.redundant.cfg"
#SMD_CFG = "${S}/bootloader/smd_info.cfg"

# CUDA and GCC Compatibility
CUDA_VERSION = "10.0"

#CUDA 10.0 compatibility
GCCVERSION = "7.%"
require contrib/conf/include/gcc-compat.conf

# BLOB Stuff. Don't change size of info file.
INFO_FILE_BLOCKS = "1"
IMAGE_FILE_BLOCKS = "90000"
DTB_FILE_BLOCKS = "2000"
INITRD_FILE_BLOCKS = "6000"
ROOTFS_FILE_BLOCKS = "7900000"

# Number of bytes used to represent a filesize (shouldn't have to change)
INFO_BYTES = "15"

# Do not modify, should stay above INFO_BYTES * 4
BLOCK_SIZE = "512"

# Number of blocks before APP starts (8 + 4096)
PARTITION_OFFSET = "4104"

# Max of the first four, for U-Boot. Making this too large will cause U-Boot to run out of memory
# during TMR.
MAX_FILE_BLOCKS = "$(echo "define max(a,b) { if (a<b) return b else return a}; max(max(${INFO_FILE_BLOCKS},${IMAGE_FILE_BLOCKS}),max(${DTB_FILE_BLOCKS},${INITRD_FILE_BLOCKS}))" | bc)"

INFO_FILE_OFFSET = "0"
INFO_HASH_OFFSET = "$(echo "${INFO_FILE_OFFSET} + ${INFO_FILE_BLOCKS}" | bc)"
IMAGE_FILE_OFFSET = "$(echo "${INFO_HASH_OFFSET} + 1" | bc)"
IMAGE_HASH_OFFSET = "$(echo "${IMAGE_FILE_OFFSET} + ${IMAGE_FILE_BLOCKS}" | bc)"
DTB_FILE_OFFSET = "$(echo "${IMAGE_HASH_OFFSET} + 1" | bc)"
DTB_HASH_OFFSET = "$(echo "${DTB_FILE_OFFSET} + ${DTB_FILE_BLOCKS}" | bc)"
INITRD_FILE_OFFSET = "$(echo "${DTB_HASH_OFFSET} + 1" | bc)"
INITRD_HASH_OFFSET = "$(echo "${INITRD_FILE_OFFSET} + ${INITRD_FILE_BLOCKS}" | bc)"
ROOTFS_FILE_OFFSET = "$(echo "${INITRD_HASH_OFFSET} + 1" | bc)"
ROOTFS_HASH_OFFSET = "$(echo "${ROOTFS_FILE_OFFSET} + ${ROOTFS_FILE_BLOCKS}" | bc)"
```

## conf/machine/jetson-tx2i-sol-apl.conf
```bitbake
#@TYPE: Machine
#@NAME: Nvidia Jetson TX2i with linaro gcc
#@DESCRIPTION: Nvidia Jetson TX2i dev board

TEGRA_UCM ?= "ucm1"
NVPMODEL ?= "nvpmodel_t186_storm_${TEGRA_UCM}"

TEGRA_BOARDID ?= "3489"
TEGRA_FAB ?= "300"
# Extracted from l4t_generate_soc_bup.sh for BOARDID=3489 and board=jetson-tx2i
TEGRA_BUPGEN_SPECS ?= "fab=300"

require conf/machine/include/tegra186.inc

KERNEL_DEVICETREE ?= "_ddot_/_ddot_/_ddot_/_ddot_/nvidia/platform/t18x/quill/kernel-dts/tegra186-quill-p3489-1000-a00-00-${TEGRA_UCM}.dtb"
KERNEL_ARGS ?= "console=ttyS0,115200 console=tty0 OS=l4t fbcon=map:0"

MACHINE_FEATURES += "ext2 ext3 vfat"

UBOOT_MACHINE = "p2771-0000-500_defconfig"

EMMC_SIZE ?= "31276924928"
EMMC_DEVSECT_SIZE ?= "512"
BOOTPART_SIZE ?= "8388608"
BOOTPART_LIMIT ?= "10485760"
ODMDATA ?= "0x1090000"
EMMC_BCT ?= "P3489_A00_8GB_Samsung_8GB_lpddr4_204Mhz_P134_A02_ECC_en_l4t.cfg"
NVIDIA_BOARD ?= "t186ref"



#Specify INITRAMFS, specifically normal boot sequence, ext4.live or blob.live
INITRAMFS_IMAGE = "tegra-minimal-initramfs"
#INITRAMFS_IMAGE = "tegra-minimal-initramfs-ext4.live"
#INITRAMFS_IMAGE = "tegra-minimal-initramfs-blob.live"


#Specify partition layout (how many copies of things do you want where)
#PARTITION_LAYOUT_TEMPLATE = "flash_t186_redundant_rootfs.xml"
PARTITION_LAYOUT_TEMPLATE = "flash_t186_default_rootfs.xml"

#Specify rootfs size (this may be duplicated based on partition layout)
#ROOTFSPART_SIZE = "4294967296"
ROOTFSPART_SIZE = "30064771072"

#Specify if NVIDIA redundancy is enabled or not
#SMD_CFG = "${S}/bootloader/smd_info.redundant.cfg"
SMD_CFG = "${S}/bootloader/smd_info.cfg"

#Added docker capabilty onboard
DISTRO_FEATURES_append = " virtualization"

GCCVERSION = "linaro-7.%"

# GCC 7 doesn't support fmacro-prefix-map, results in "error: cannot compute suffix of object files: cannot compile"
# Change the value from bitbake.conf DEBUG_PREFIX_MAP to remove -fmacro-prefix-map
DEBUG_PREFIX_MAP = "-fdebug-prefix-map=${WORKDIR}=/usr/src/debug/${PN}/${EXTENDPE}${PV}-${PR} \
                    -fdebug-prefix-map=${STAGING_DIR_HOST}= \
                    -fdebug-prefix-map=${STAGING_DIR_NATIVE}= \
                    "
```

## conf/machine/jetson-tx2i-sol-base.conf
```bitbake
#@TYPE: Machine
#@NAME: Nvidia Jetson TX2i with linaro gcc
#@DESCRIPTION: Nvidia Jetson TX2i dev board

TEGRA_UCM ?= "ucm1"
NVPMODEL ?= "nvpmodel_t186_storm_${TEGRA_UCM}"

TEGRA_BOARDID ?= "3489"
TEGRA_FAB ?= "300"
# Extracted from l4t_generate_soc_bup.sh for BOARDID=3489 and board=jetson-tx2i
TEGRA_BUPGEN_SPECS ?= "fab=300"

#Specify RT Kernel
PREFERRED_PROVIDER_virtual/kernel ?= "linux-tegra-rt"
#PREFERRED_PROVIDER_virtual/kernel ?= "linux-tegra"

require conf/machine/include/tegra186.inc

#Specify Carrier Board DTB
KERNEL_DEVICETREE ?= "_ddot_/_ddot_/_ddot_/_ddot_/nvidia/platform/t18x/quill/kernel-dts/tegra186-quill-p3489-1000-a00-00-${TEGRA_UCM}.dtb"
KERNEL_ARGS ?= "console=ttyS0,115200 console=tty0 OS=l4t fbcon=map:0"

MACHINE_FEATURES += "ext2 ext3 vfat"

UBOOT_MACHINE = "p2771-0000-500_defconfig"

EMMC_SIZE ?= "31276924928"
EMMC_DEVSECT_SIZE ?= "512"
BOOTPART_SIZE ?= "8388608"
BOOTPART_LIMIT ?= "10485760"
ODMDATA ?= "0x1090000"
EMMC_BCT ?= "P3489_A00_8GB_Samsung_8GB_lpddr4_204Mhz_P134_A02_ECC_en_l4t.cfg"
NVIDIA_BOARD ?= "t186ref"



#Specify INITRAMFS, specifically normal boot sequence, ext4.live or blob.live
INITRAMFS_IMAGE = "tegra-minimal-initramfs"
#INITRAMFS_IMAGE = "tegra-minimal-initramfs-ext4.live"
#INITRAMFS_IMAGE = "tegra-minimal-initramfs-blob.live"


#Specify partition layout (how many copies of things do you want where)
#PARTITION_LAYOUT_TEMPLATE = "flash_t186_redundant_rootfs.xml"
PARTITION_LAYOUT_TEMPLATE = "flash_t186_default_rootfs.xml"

#Specify rootfs size (this may be duplicated based on partition layout)
#ROOTFSPART_SIZE = "4294967296"
ROOTFSPART_SIZE = "30064771072"

#Specify if NVIDIA redundancy is enabled or not
#SMD_CFG = "${S}/bootloader/smd_info.redundant.cfg"
#SMD_CFG = "${S}/bootloader/smd_info.cfg"

# CUDA and GCC Compatibility
CUDA_VERSION = "10.0"

#CUDA 10.0 compatibility
GCCVERSION = "7.%"
require contrib/conf/include/gcc-compat.conf
```
